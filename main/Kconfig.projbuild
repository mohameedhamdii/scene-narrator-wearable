## main/Kconfig.projbuild
```kconfig
menu "Scene Narrator"

    config SCENE_NARRATOR_SIMULATE
        bool "Enable hardware simulation mode"
        default n
        help
            Run without physical camera, audio, or button hardware.
            Useful for development on ESP-IDF simulator or CI.
            Disable for real ESP32-P4 hardware deployment.

    config SCENE_NARRATOR_BATTERY_MONITOR
        bool "Enable battery voltage monitoring"
        default n
        help
            Read battery voltage from GPIO ADC with 2:1 divider.
            Disable if no voltage divider is wired to avoid false shutdowns.

endmenu
```

## sdkconfig.defaults
```kconfig
# Scene Narrator — ESP32-P4 defaults
CONFIG_IDF_TARGET="esp32p4"
CONFIG_ESPTOOLPY_FLASHSIZE_16MB=y
CONFIG_SPIRAM=y
CONFIG_SPIRAM_MODE_OCT=y
CONFIG_SPIRAM_SPEED_80M=y
CONFIG_SPIRAM_USE_MALLOC=y
CONFIG_SPIRAM_MALLOC_ALWAYSINTERNAL=16384
CONFIG_FREERTOS_HZ=1000
CONFIG_PM_ENABLE=y
CONFIG_PM_DFS_INIT_AUTO=y
CONFIG_ESP32P4_DEFAULT_CPU_FREQ_400=y
CONFIG_ESP_MAIN_TASK_STACK_SIZE=8192
CONFIG_ESP_SYSTEM_EVENT_TASK_STACK_SIZE=4096
CONFIG_LOG_DEFAULT_LEVEL_INFO=y

# SPIFFS for model storage
CONFIG_PARTITION_TABLE_CUSTOM=y
CONFIG_PARTITION_TABLE_CUSTOM_FILENAME="partitions.csv"

# Production defaults — enable simulation in menuconfig for desk testing
CONFIG_SCENE_NARRATOR_SIMULATE=n
# CONFIG_SCENE_NARRATOR_BATTERY_MONITOR is not set
```
